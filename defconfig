## defconfig
```kconfig
CONFIG_TARGET_x86=y
CONFIG_TARGET_x86_64=y
CONFIG_TARGET_x86_64_Generic=y
# CONFIG_PACKAGE_autosamba is not set
CONFIG_PACKAGE_boost=y
CONFIG_PACKAGE_boost-date_time=y
CONFIG_PACKAGE_boost-program_options=y
CONFIG_PACKAGE_boost-system=y
# CONFIG_PACKAGE_etherwake is not set
CONFIG_PACKAGE_frpc=y
CONFIG_PACKAGE_frps=y
CONFIG_PACKAGE_ipt2socks=y
# CONFIG_PACKAGE_iptables-mod-ipsec is not set
CONFIG_PACKAGE_kcptun-client=y
# CONFIG_PACKAGE_kmod-crypto-cbc is not set
# CONFIG_PACKAGE_kmod-crypto-deflate is not set
# CONFIG_PACKAGE_kmod-crypto-des is not set
# CONFIG_PACKAGE_kmod-crypto-echainiv is not set
# CONFIG_PACKAGE_kmod-crypto-hmac is not set
# CONFIG_PACKAGE_kmod-crypto-md5 is not set
# CONFIG_PACKAGE_kmod-crypto-rng is not set
# CONFIG_PACKAGE_kmod-crypto-sha256 is not set
# CONFIG_PACKAGE_kmod-crypto-wq is not set
# CONFIG_PACKAGE_kmod-ipsec is not set
# CONFIG_PACKAGE_kmod-ipt-ipsec is not set
# CONFIG_PACKAGE_kmod-iptunnel6 is not set
CONFIG_PACKAGE_libevent2=y
# CONFIG_PACKAGE_libgmp is not set
CONFIG_PACKAGE_libnss=y
CONFIG_PACKAGE_libsqlite3=y
CONFIG_PACKAGE_luci-app-frpc=y
CONFIG_PACKAGE_luci-app-frps=y
# CONFIG_PACKAGE_luci-app-ipsec-vpnd is not set
# CONFIG_PACKAGE_luci-app-ramfree is not set
# CONFIG_PACKAGE_luci-app-samba is not set
CONFIG_PACKAGE_luci-app-ssr-plus_INCLUDE_Kcptun=y
CONFIG_PACKAGE_luci-app-ssr-plus_INCLUDE_NaiveProxy=y
CONFIG_PACKAGE_luci-app-ssr-plus_INCLUDE_Redsocks2=y
CONFIG_PACKAGE_luci-app-ssr-plus_INCLUDE_Shadowsocks_Rust=y
CONFIG_PACKAGE_luci-app-ssr-plus_INCLUDE_Trojan=y
CONFIG_PACKAGE_luci-app-ssr-plus_INCLUDE_V2ray_plugin=y
# CONFIG_PACKAGE_luci-app-vsftpd is not set
# CONFIG_PACKAGE_luci-app-wol is not set
# CONFIG_PACKAGE_luci-app-xlnetacc is not set
CONFIG_PACKAGE_luci-i18n-frpc-zh-cn=y
CONFIG_PACKAGE_luci-i18n-frps-zh-cn=y
CONFIG_PACKAGE_luci-theme-argon=y
CONFIG_PACKAGE_naiveproxy=y
CONFIG_PACKAGE_nano=y
CONFIG_PACKAGE_nspr=y
CONFIG_PACKAGE_redsocks2=y
CONFIG_PACKAGE_shadowsocks-rust-sslocal=y
# CONFIG_PACKAGE_strongswan is not set
# CONFIG_PACKAGE_strongswan-charon is not set
# CONFIG_PACKAGE_strongswan-ipsec is not set
# CONFIG_PACKAGE_strongswan-minimal is not set
# CONFIG_PACKAGE_strongswan-mod-aes is not set
# CONFIG_PACKAGE_strongswan-mod-gmp is not set
# CONFIG_PACKAGE_strongswan-mod-hmac is not set
# CONFIG_PACKAGE_strongswan-mod-kernel-netlink is not set
# CONFIG_PACKAGE_strongswan-mod-nonce is not set
# CONFIG_PACKAGE_strongswan-mod-pubkey is not set
# CONFIG_PACKAGE_strongswan-mod-random is not set
# CONFIG_PACKAGE_strongswan-mod-sha1 is not set
# CONFIG_PACKAGE_strongswan-mod-socket-default is not set
# CONFIG_PACKAGE_strongswan-mod-stroke is not set
# CONFIG_PACKAGE_strongswan-mod-updown is not set
# CONFIG_PACKAGE_strongswan-mod-x509 is not set
# CONFIG_PACKAGE_strongswan-mod-xauth-generic is not set
# CONFIG_PACKAGE_strongswan-mod-xcbc is not set
CONFIG_PACKAGE_trojan=y
CONFIG_PACKAGE_v2ray=y
CONFIG_PACKAGE_v2ray-plugin=y
# CONFIG_PACKAGE_vsftpd-alt is not set
# CONFIG_PACKAGE_wol is not set
CONFIG_SQLITE_FTS3=y
CONFIG_SQLITE_RTREE=y
CONFIG_TARGET_ROOTFS_PARTSIZE=2048
CONFIG_V2RAY_COMPRESS_GOPROXY=y
CONFIG_V2RAY_COMPRESS_UPX=y
CONFIG_V2RAY_DISABLE_NONE=y
CONFIG_V2RAY_EXCLUDE_ASSETS=y
CONFIG_V2RAY_EXCLUDE_V2CTL=y
CONFIG_V2RAY_JSON_INTERNAL=y
CONFIG_boost-compile-visibility-hidden=y
CONFIG_boost-runtime-shared=y
CONFIG_boost-static-and-shared-libs=y
CONFIG_boost-variant-release=y
CONFIG_PACKAGE_SAMBA_MAX_DEBUG_LEVEL=-1
CONFIG_PACKAGE_samba36-server=y
CONFIG_PACKAGE_wsdd2=y
```
